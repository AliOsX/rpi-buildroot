## package/stak/Config.in
```kconfig
menu "Stak"
	depends on BR2_arm
	source package/stak/ottosdk/Config.in

	menu "Libraries"
		source package/stak/platform/raspberrypi/libbcm2835/Config.in
		source package/stak/platform/raspberrypi/armmem/Config.in
		source package/stak/platform/raspberrypi/nanovg/Config.in
		source package/stak/platform/raspberrypi/bx/Config.in
		source package/stak/platform/raspberrypi/bgfx/Config.in
		source package/stak/platform/rtl81xx/Config.in
	endmenu
endmenu
```

## package/stak/ottosdk/Config.in
```kconfig
config BR2_PACKAGE_OTTOSDK
	bool "ottosdk"
	depends on BR2_arm
	help
	  Hardware Test For Stak
```

## package/stak/platform/raspberrypi/onion/Config.in
```kconfig
config BR2_PACKAGE_ONION
	bool "onion"
	depends on BR2_arm
	help
	  Onion is a lightweight C library to create simple HTTP servers and Web Applications.
```
